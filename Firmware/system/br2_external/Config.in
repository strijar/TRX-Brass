## Firmware/system/br2_external/Config.in
```kconfig
source "$BR2_EXTERNAL_BRASS_PATH/package/axis-fifo/Config.in"
source "$BR2_EXTERNAL_BRASS_PATH/package/rhvoice/Config.in"
source "$BR2_EXTERNAL_BRASS_PATH/package/ext-liquid-dsp/Config.in"
source "$BR2_EXTERNAL_BRASS_PATH/package/libcyaml/Config.in"
source "$BR2_EXTERNAL_BRASS_PATH/package/lpcnet/Config.in"
source "$BR2_EXTERNAL_BRASS_PATH/package/codec2/Config.in"
source "$BR2_EXTERNAL_BRASS_PATH/package/libspecbleach/Config.in"
```

## Firmware/system/br2_external/configs/brass7010_defconfig
```kconfig
BR2_arm=y
BR2_cortex_a9=y
BR2_ARM_ENABLE_NEON=y
BR2_ARM_ENABLE_VFP=y
BR2_ARM_FPU_NEON=y
BR2_PACKAGE_HOST_LINUX_HEADERS_CUSTOM_6_1=y
BR2_TOOLCHAIN_BUILDROOT_CXX=y
BR2_PACKAGE_HOST_GDB=y
BR2_CCACHE=y
BR2_TARGET_GENERIC_HOSTNAME="brass"
BR2_TARGET_GENERIC_ISSUE="Welcome to TRX Brass"
BR2_ROOTFS_DEVICE_CREATION_DYNAMIC_EUDEV=y
BR2_TARGET_GENERIC_ROOT_PASSWD="123"
BR2_SYSTEM_DHCP="eth0"
BR2_ROOTFS_OVERLAY="$(BR2_EXTERNAL_BRASS_PATH)/board/brass/linux/rootfs-overlay"
BR2_ROOTFS_POST_BUILD_SCRIPT="$(BR2_EXTERNAL_BRASS_PATH)/board/brass/post-build.sh"
BR2_ROOTFS_POST_IMAGE_SCRIPT="$(BR2_EXTERNAL_BRASS_PATH)/board/brass/post-image.sh"
BR2_ROOTFS_POST_SCRIPT_ARGS="7010"
BR2_LINUX_KERNEL=y
BR2_LINUX_KERNEL_CUSTOM_TARBALL=y
BR2_LINUX_KERNEL_CUSTOM_TARBALL_LOCATION="$(call github,Xilinx,linux-xlnx,xlnx_rebase_v6.1_LTS_2023.1)/xlnx_rebase_v6.1_LTS_2023.1.tar.gz"
BR2_LINUX_KERNEL_PATCH="$(BR2_EXTERNAL_BRASS_PATH)/board/brass/linux/"
BR2_LINUX_KERNEL_USE_CUSTOM_CONFIG=y
BR2_LINUX_KERNEL_CUSTOM_CONFIG_FILE="$(BR2_EXTERNAL_BRASS_PATH)/board/brass/linux/linux.config"
BR2_LINUX_KERNEL_CUSTOM_LOGO_PATH="$(BR2_EXTERNAL_BRASS_PATH)/board/brass/linux/logo.png"
BR2_LINUX_KERNEL_UIMAGE=y
BR2_LINUX_KERNEL_UIMAGE_LOADADDR="0x8000"
BR2_LINUX_KERNEL_DTS_SUPPORT=y
BR2_LINUX_KERNEL_CUSTOM_DTS_PATH="$(BR2_EXTERNAL_BRASS_PATH)/board/brass/7010/brass.dts"
BR2_LINUX_KERNEL_NEEDS_HOST_OPENSSL=y
BR2_PACKAGE_ALSA_UTILS=y
BR2_PACKAGE_ALSA_UTILS_ALSACONF=y
BR2_PACKAGE_ALSA_UTILS_ALSALOOP=y
BR2_PACKAGE_ALSA_UTILS_ALSAUCM=y
BR2_PACKAGE_ALSA_UTILS_ALSATPLG=y
BR2_PACKAGE_ALSA_UTILS_AMIDI=y
BR2_PACKAGE_ALSA_UTILS_AMIXER=y
BR2_PACKAGE_ALSA_UTILS_APLAY=y
BR2_PACKAGE_ALSA_UTILS_APLAYMIDI=y
BR2_PACKAGE_ALSA_UTILS_ARECORDMIDI=y
BR2_PACKAGE_ALSA_UTILS_ASEQDUMP=y
BR2_PACKAGE_ALSA_UTILS_ASEQNET=y
BR2_PACKAGE_ALSA_UTILS_IECSET=y
BR2_PACKAGE_ALSA_UTILS_SPEAKER_TEST=y
BR2_PACKAGE_BLUEZ_ALSA=y
BR2_PACKAGE_LAME=y
BR2_PACKAGE_MPG123=y
BR2_PACKAGE_PIPEWIRE=y
BR2_PACKAGE_PULSEAUDIO=y
BR2_PACKAGE_PULSEAUDIO_DAEMON=y
BR2_PACKAGE_GDB=y
BR2_PACKAGE_E2FSPROGS=y
BR2_PACKAGE_LIBERATION=y
BR2_PACKAGE_FB_TEST_APP=y
BR2_PACKAGE_SDL2=y
BR2_PACKAGE_LINUX_FIRMWARE=y
BR2_PACKAGE_LINUX_FIRMWARE_AMLOGIC=y
BR2_PACKAGE_LINUX_FIRMWARE_IBT=y
BR2_PACKAGE_LINUX_FIRMWARE_MEDIATEK_MT7650=y
BR2_PACKAGE_LINUX_FIRMWARE_MEDIATEK_MT7921_BT=y
BR2_PACKAGE_LINUX_FIRMWARE_MEDIATEK_MT7922_BT=y
BR2_PACKAGE_LINUX_FIRMWARE_QUALCOMM_6174A_BT=y
BR2_PACKAGE_LINUX_FIRMWARE_QUALCOMM_9377_BT=y
BR2_PACKAGE_LINUX_FIRMWARE_AR3011=y
BR2_PACKAGE_LINUX_FIRMWARE_AR3012_USB=y
BR2_PACKAGE_LINUX_FIRMWARE_RTL_87XX_BT=y
BR2_PACKAGE_LINUX_FIRMWARE_RTL_88XX_BT=y
BR2_PACKAGE_LINUX_FIRMWARE_TI_CC2560=y
BR2_PACKAGE_DBUS_CPP=y
BR2_PACKAGE_DBUS_GLIB=y
BR2_PACKAGE_DBUS_TRIGGERD=y
BR2_PACKAGE_EUDEV_RULES_GEN=y
BR2_PACKAGE_EVEMU=y
BR2_PACKAGE_EVTEST=y
BR2_PACKAGE_GPSD=y
BR2_PACKAGE_GPSD_DEVICES="/dev/ttyACM0"
BR2_PACKAGE_GPSD_ASHTECH=y
BR2_PACKAGE_GPSD_EARTHMATE=y
BR2_PACKAGE_GPSD_EVERMORE=y
BR2_PACKAGE_GPSD_FURY=y
BR2_PACKAGE_GPSD_FV18=y
BR2_PACKAGE_GPSD_GARMIN=y
BR2_PACKAGE_GPSD_GARMIN_SIMPLE_TXT=y
BR2_PACKAGE_GPSD_GEOSTAR=y
BR2_PACKAGE_GPSD_GPSCLOCK=y
BR2_PACKAGE_GPSD_GREIS=y
BR2_PACKAGE_GPSD_ISYNC=y
BR2_PACKAGE_GPSD_ITRAX=y
BR2_PACKAGE_GPSD_NMEA2000=y
BR2_PACKAGE_GPSD_OCEANSERVER=y
BR2_PACKAGE_GPSD_ONCORE=y
BR2_PACKAGE_GPSD_RTCM104V2=y
BR2_PACKAGE_GPSD_RTCM104V3=y
BR2_PACKAGE_GPSD_SIRF=y
BR2_PACKAGE_GPSD_SKYTRAQ=y
BR2_PACKAGE_GPSD_SUPERSTAR2=y
BR2_PACKAGE_GPSD_TRIMBLE_TSIP=y
BR2_PACKAGE_GPSD_TRIPMATE=y
BR2_PACKAGE_GPSD_TRUE_NORTH=y
BR2_PACKAGE_GPSD_UBX=y
BR2_PACKAGE_LM_SENSORS=y
BR2_PACKAGE_LM_SENSORS_FANCONTROL=y
BR2_PACKAGE_LM_SENSORS_PWMCONFIG=y
BR2_PACKAGE_LSHW=y
BR2_PACKAGE_LSUIO=y
BR2_PACKAGE_POWERTOP=y
BR2_PACKAGE_USBMOUNT=y
BR2_PACKAGE_USBUTILS=y
BR2_PACKAGE_LUA=y
BR2_PACKAGE_LUA_5_3=y
BR2_PACKAGE_PYTHON3=y
BR2_PACKAGE_PYTHON_NUMPY=y
BR2_PACKAGE_PYTHON_PYBIND=y
BR2_PACKAGE_PYTHON_PYZMQ=y
BR2_PACKAGE_PYTHON_SIX=y
BR2_PACKAGE_GNUTLS=y
BR2_PACKAGE_LIBMD=y
BR2_PACKAGE_LIBNSS=y
BR2_PACKAGE_FONTCONFIG=y
BR2_PACKAGE_GIFLIB=y
BR2_PACKAGE_JPEG=y
BR2_PACKAGE_LIBPNG=y
BR2_PACKAGE_WIREPLUMBER=y
BR2_PACKAGE_LIBGPIOD=y
BR2_PACKAGE_LIBGPIOD_TOOLS=y
BR2_PACKAGE_LIBIIO=y
BR2_PACKAGE_LIBIIO_IIOD_USBD=y
BR2_PACKAGE_LIBIIO_TESTS=y
BR2_PACKAGE_LIBINPUT=y
BR2_PACKAGE_LIBXKBCOMMON=y
BR2_PACKAGE_LIBOGG=y
BR2_PACKAGE_BOOST_PYTHON=y
BR2_PACKAGE_FFTW_FAST=y
BR2_PACKAGE_PCRE=y
BR2_PACKAGE_PCRE_UCP=y
BR2_PACKAGE_PCRE2_16=y
BR2_PACKAGE_GNURADIO=y
BR2_PACKAGE_GNURADIO_AUDIO=y
BR2_PACKAGE_GNURADIO_CTRLPORT=y
BR2_PACKAGE_GNURADIO_FEC=y
BR2_PACKAGE_GNURADIO_ZEROMQ=y
BR2_PACKAGE_GNURADIO_CHANNELS=y
BR2_PACKAGE_GNURADIO_NETWORK=y
BR2_PACKAGE_GNURADIO_TRELLIS=y
BR2_PACKAGE_GNURADIO_UHD=y
BR2_PACKAGE_BLUEZ5_UTILS_OBEX=y
BR2_PACKAGE_BLUEZ5_UTILS_CLIENT=y
BR2_PACKAGE_BLUEZ5_UTILS_MONITOR=y
BR2_PACKAGE_BLUEZ5_UTILS_TOOLS=y
BR2_PACKAGE_BLUEZ5_UTILS_DEPRECATED=y
BR2_PACKAGE_ETHTOOL=y
BR2_PACKAGE_IW=y
BR2_PACKAGE_NETWORK_MANAGER=y
BR2_PACKAGE_NETWORK_MANAGER_TUI=y
BR2_PACKAGE_NETWORK_MANAGER_CLI=y
BR2_PACKAGE_NTP=y
BR2_PACKAGE_NTP_SNTP=y
BR2_PACKAGE_NTP_NTP_SHM_CLK=y
BR2_PACKAGE_NTP_NTPD_ATOM_PPS=y
BR2_PACKAGE_NTP_NTPDATE=y
BR2_PACKAGE_NTP_NTPDC=y
BR2_PACKAGE_NTP_NTPQ=y
BR2_PACKAGE_NTP_NTPTIME=y
BR2_PACKAGE_NTP_TICKADJ=y
BR2_PACKAGE_OPENSSH=y
BR2_PACKAGE_SOCAT=y
BR2_PACKAGE_WIRELESS_REGDB=y
BR2_PACKAGE_WPA_SUPPLICANT=y
BR2_PACKAGE_WPA_SUPPLICANT_AP_SUPPORT=y
BR2_PACKAGE_WPA_SUPPLICANT_WIFI_DISPLAY=y
BR2_PACKAGE_WPA_SUPPLICANT_MESH_NETWORKING=y
BR2_PACKAGE_WPA_SUPPLICANT_AUTOSCAN=y
BR2_PACKAGE_WPA_SUPPLICANT_HOTSPOT=y
BR2_PACKAGE_WPA_SUPPLICANT_DEBUG_SYSLOG=y
BR2_PACKAGE_WPA_SUPPLICANT_WPS=y
BR2_PACKAGE_WPA_SUPPLICANT_WPA3=y
BR2_PACKAGE_WPA_SUPPLICANT_CLI=y
BR2_PACKAGE_WPA_SUPPLICANT_WPA_CLIENT_SO=y
BR2_PACKAGE_WPA_SUPPLICANT_PASSPHRASE=y
BR2_PACKAGE_WPA_SUPPLICANT_DBUS=y
BR2_PACKAGE_WPA_SUPPLICANT_DBUS_INTROSPECTION=y
BR2_PACKAGE_SCREEN=y
BR2_PACKAGE_UTIL_LINUX_BINARIES=y
BR2_PACKAGE_UTIL_LINUX_MOUNT=y
BR2_PACKAGE_UTIL_LINUX_RFKILL=y
BR2_PACKAGE_MC=y
BR2_PACKAGE_NANO=y
BR2_TARGET_ROOTFS_EXT2=y
BR2_TARGET_ROOTFS_EXT2_4=y
BR2_TARGET_ROOTFS_EXT2_SIZE="1G"
BR2_TARGET_UBOOT=y
BR2_TARGET_UBOOT_BUILD_SYSTEM_KCONFIG=y
BR2_TARGET_UBOOT_CUSTOM_TARBALL=y
BR2_TARGET_UBOOT_CUSTOM_TARBALL_LOCATION="$(call github,Xilinx,u-boot-xlnx,xlnx_rebase_v2023.01_2023.1)/xlnx_rebase_v2023.01_2023.1.tar.gz"
BR2_TARGET_UBOOT_USE_CUSTOM_CONFIG=y
BR2_TARGET_UBOOT_CUSTOM_CONFIG_FILE="$(BR2_EXTERNAL_BRASS_PATH)/board/brass/7010/uboot.config"
BR2_TARGET_UBOOT_NEEDS_DTC=y
BR2_TARGET_UBOOT_NEEDS_OPENSSL=y
BR2_TARGET_UBOOT_NEEDS_GNUTLS=y
BR2_TARGET_UBOOT_FORMAT_IMG=y
BR2_TARGET_UBOOT_SPL=y
BR2_TARGET_UBOOT_SPL_NAME="spl/boot.bin"
BR2_TARGET_UBOOT_CUSTOM_DTS_PATH="$(BR2_EXTERNAL_BRASS_PATH)/board/brass/uboot/brass.dts"
BR2_TARGET_UBOOT_CUSTOM_MAKEOPTS="DEVICE_TREE=brass"
BR2_PACKAGE_HOST_DOSFSTOOLS=y
BR2_PACKAGE_HOST_GENIMAGE=y
BR2_PACKAGE_HOST_MTOOLS=y
BR2_PACKAGE_HOST_UBOOT_TOOLS_ENVIMAGE=y
BR2_PACKAGE_HOST_UBOOT_TOOLS_ENVIMAGE_SOURCE="$(BR2_EXTERNAL_BRASS_PATH)/board/brass/uboot/boot-env.txt"
BR2_PACKAGE_HOST_UBOOT_TOOLS_ENVIMAGE_SIZE="0x20000"
BR2_PACKAGE_AXIS_FIFO=y
BR2_PACKAGE_RHVOICE=y
BR2_PACKAGE_RHVOICE_ENGLISH=y
BR2_PACKAGE_RHVOICE_SLT=y
BR2_PACKAGE_EXT_LIQUID_DSP=y
BR2_PACKAGE_EXT_LIQUID_DSP_FAST=y
BR2_PACKAGE_LIBCYAML=y
```

## Firmware/system/br2_external/configs/brass_defconfig
```kconfig
BR2_arm=y
BR2_cortex_a9=y
BR2_ARM_ENABLE_NEON=y
BR2_ARM_ENABLE_VFP=y
BR2_PACKAGE_HOST_LINUX_HEADERS_CUSTOM_6_1=y
BR2_TOOLCHAIN_BUILDROOT_CXX=y
BR2_TARGET_GENERIC_HOSTNAME="brass"
BR2_TARGET_GENERIC_ISSUE="Welcome to TRX Brass"
BR2_TARGET_GENERIC_ROOT_PASSWD="123"
BR2_ROOTFS_POST_BUILD_SCRIPT="board/zynq/post-build.sh"
BR2_ROOTFS_POST_IMAGE_SCRIPT="board/zynq/post-image.sh"
BR2_LINUX_KERNEL=y
BR2_LINUX_KERNEL_CUSTOM_TARBALL=y
BR2_LINUX_KERNEL_CUSTOM_TARBALL_LOCATION="$(call github,Xilinx,linux-xlnx,xlnx_rebase_v6.1_LTS_2023.1)/xlnx_rebase_v6.1_LTS_2023.1.tar.gz"
BR2_LINUX_KERNEL_DEFCONFIG="xilinx_zynq"
BR2_LINUX_KERNEL_UIMAGE=y
BR2_LINUX_KERNEL_UIMAGE_LOADADDR="0x8000"
BR2_LINUX_KERNEL_DTS_SUPPORT=y
BR2_LINUX_KERNEL_INTREE_DTS_NAME="zynq-zed"
BR2_LINUX_KERNEL_NEEDS_HOST_OPENSSL=y
BR2_PACKAGE_SQLITE=y
BR2_PACKAGE_NTP=y
BR2_PACKAGE_NTP_SNTP=y
BR2_PACKAGE_NTP_NTP_KEYGEN=y
BR2_PACKAGE_NTP_NTP_SHM_CLK=y
BR2_PACKAGE_NTP_NTPD_ATOM_PPS=y
BR2_PACKAGE_NTP_NTPDATE=y
BR2_PACKAGE_NTP_NTPDC=y
BR2_PACKAGE_NTP_NTPQ=y
BR2_PACKAGE_NTP_NTPSNMPD=y
BR2_PACKAGE_NTP_NTPTIME=y
BR2_PACKAGE_NTP_TICKADJ=y
BR2_PACKAGE_OPENSSH=y
BR2_PACKAGE_MC=y
BR2_TARGET_ROOTFS_EXT2=y
BR2_TARGET_ROOTFS_EXT2_4=y
BR2_TARGET_ROOTFS_EXT2_SIZE="1G"
BR2_TARGET_UBOOT=y
BR2_TARGET_UBOOT_BUILD_SYSTEM_KCONFIG=y
BR2_TARGET_UBOOT_CUSTOM_TARBALL=y
BR2_TARGET_UBOOT_CUSTOM_TARBALL_LOCATION="$(call github,Xilinx,u-boot-xlnx,xlnx_rebase_v2023.01_2023.1)/xlnx_rebase_v2023.01_2023.1.tar.gz"
BR2_TARGET_UBOOT_BOARD_DEFCONFIG="xilinx_zynq_virt"
BR2_TARGET_UBOOT_NEEDS_DTC=y
BR2_TARGET_UBOOT_NEEDS_OPENSSL=y
BR2_TARGET_UBOOT_NEEDS_GNUTLS=y
BR2_TARGET_UBOOT_FORMAT_IMG=y
BR2_TARGET_UBOOT_SPL=y
BR2_TARGET_UBOOT_SPL_NAME="spl/boot.bin"
BR2_TARGET_UBOOT_CUSTOM_MAKEOPTS="DEVICE_TREE=zynq-zed"
BR2_PACKAGE_HOST_DOSFSTOOLS=y
BR2_PACKAGE_HOST_GENIMAGE=y
BR2_PACKAGE_HOST_MTOOLS=y
```

## Firmware/system/br2_external/package/axis-fifo/Config.in
```kconfig
config BR2_PACKAGE_AXIS_FIFO
	bool "axis-fifo"
	depends on BR2_LINUX_KERNEL
	help
	  Xilinx AXI-Stream FIFO v4.1/v4.2 IP core driver

	  https://github.com/jacobfeder/axisfifo
```

## Firmware/system/br2_external/package/brass-gui/Config.in
```kconfig
config BR2_PACKAGE_BRASS_GUI
    bool "brass_gui"
    select BR2_AXIS_FIFO
    select BR2_PACKAGE_EXT_LIQUID_DSP
    select BR2_PACKAGE_LIBCYAML
    select BR2_PACKAGE_LIBSPECBLEACH
    select BR2_PACKAGE_RHVOICE
    select BR2_PACKAGE_LIBPNG
    help
      Brass GUI application
```

## Firmware/system/br2_external/package/codec2/Config.in
```kconfig
config BR2_PACKAGE_CODEC2
	bool "codec2"
	help
        Codec 2 is an open source (LGPL 2.1) low bit rate speech codec: http://rowetel.com/codec2.html written in C99 standard C.

        Also included:

        The FreeDV API for digital voice over radio.
        FreeDV is an open source digital voice protocol that integrates modems, codecs, 
        and FEC README_freedv HF OFDM and FSK modems, FEC used in the FreeDV API
        APIs for packet data over radio README_data
        An STM32 embedded version of FreeDV 1600/700D/700E for the SM1000
```

## Firmware/system/br2_external/package/ezdma/Config.in
```kconfig
comment "EZDMA needs a Linux kernel to be built"
	depends on !BR2_LINUX_KERNEL

config BR2_PACKAGE_EZDMA
	bool "ezdma"
	depends on BR2_LINUX_KERNEL
	help
	  Simple, zero-copy DMA to/from userspace.
```

## Firmware/system/br2_external/package/libcyaml/Config.in
```kconfig
config BR2_PACKAGE_LIBCYAML
	bool "libcyaml"
	select BR2_PACKAGE_LIBYAML
	help
        LibCYAML is a C library for reading and writing structured YAML documents. 
        It is written in ISO C11 and licensed under the ISC licence.

        https://github.com/tlsa/libcyaml
```

## Firmware/system/br2_external/package/libspecbleach/Config.in
```kconfig
config BR2_PACKAGE_LIBSPECBLEACH
	bool "libspecbleach"
	help
		C library for audio noise reduction and other spectral effects

		https://github.com/lucianodato/libspecbleach
```

## Firmware/system/br2_external/package/lpcnet/Config.in
```kconfig
config BR2_PACKAGE_LPCNET
	bool "lpcnet"
	select BR2_PACKAGE_LPCNET
	help
        LPCNet for FreeDV

        Experimental version of LPCNet that has been used to develop FreeDV 2020 -
        a HF radio Digital Voice mode for over the air experimentation with
        Neural Net speech coding.
        Possibly the first use of Neural Net speech coding in real world operation
```
